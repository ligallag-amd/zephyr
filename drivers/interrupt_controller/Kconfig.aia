## drivers/interrupt_controller/Kconfig.aia
```kconfig
# SPDX-License-Identifier: Apache-2.0

config IMSIC
	bool "Incoming Message Signalled Interrupt Controller (IMSIC)"
	default y
	depends on DT_HAS_RISCV_IMSICS_ENABLED
	select MULTI_LEVEL_INTERRUPTS
	select MULTI_LEVEL_OFFSET_INTERRUPTS
	help
	  RISC-V Advanced Interrupt Architecture support for external
	  interrupt lines via Advanced Platform Level Interrupt
	  Controller (APLIC).

config APLIC
	bool "RISC-V Advanced Platform Level Interrupt Controller (APLIC)"
	default y
	depends on DT_HAS_RISCV_APLIC_ENABLED
	select MULTI_LEVEL_INTERRUPTS
	select MULTI_LEVEL_OFFSET_INTERRUPTS
	help
	  RISC-V Advanced Interrupt Architecture support for message
	  signalled interrupts via Incoming Message Signalled Interrupt
	  Controller (IMSIC).
```

## dts/bindings/interrupt-controller/riscv,aplic.yaml
```yaml
# Copyright (c) 2025, AMD Inc.
# SPDX-License-Identifier: Apache-2.0

description: RISC-V advanced platform-local interrupt controller

compatible: "riscv,aplic"

include: [interrupt-controller.yaml, base.yaml]

properties:
  reg:
    required: true

  msi-parent:
    type: phandle
    description: parent IMSIC, if implemented

  riscv,num-sources:
    type: int
    description: number of wired interrupts supported
    required: true

  riscv,children:
    type: phandle-array
    specifier-space: riscv,child
    description: subordinate interrupt domains

  riscv,delegate:
    type: phandle-array
    specifier-space: riscv,delegate
    description: subordinate interrupt domain delegation map

  "#interrupt-cells":
    const: 3

  "#riscv,child-cells":
    type: int
    const: 0

  "#riscv,delegate-cells":
    type: int
    const: 2

"riscv,delegate-cells":
  - start
  - end

interrupt-cells:
  - irq
  - sense
  - priority
```

## dts/bindings/interrupt-controller/riscv,imsic.yaml
```yaml
# Copyright (c) 2025, AMD Inc.
# SPDX-License-Identifier: Apache-2.0

description: RISC-V incoming MSI interrupt file

compatible: "riscv,imsic"

include: [base.yaml]

properties:
  reg:
    required: true

  cpu-id:
    type: int
    description: interrupt file hart ID
    required: true
```

## dts/bindings/interrupt-controller/riscv,imsics.yaml
```yaml
# Copyright (c) 2025, AMD Inc.
# SPDX-License-Identifier: Apache-2.0

description: RISC-V incoming MSI interrupt controller

compatible: "riscv,imsics"

include: [interrupt-controller.yaml, base.yaml]

properties:
  reg:
    required: true

  msi-controller:
    type: boolean
    required: true

  riscv,num-ids:
    type: int
    description: number of MSI IDs supported
    required: true

  riscv,guest-index-bits:
    type: int

  "#interrupt-cells":
    const: 0
```
